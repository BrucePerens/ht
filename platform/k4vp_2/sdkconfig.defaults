## platform/k4vp_2/sdkconfig.defaults
```kconfig
# 2023-and-newer ESP32-WROOM-32E-N4 use revision 3.1
CONFIG_BOOTLOADER_LOG_LEVEL_NONE=y
CONFIG_ESP32_REV_MIN_3_1=y
CONFIG_ESP_CONSOLE_UART_BAUDRATE=460800
CONFIG_ESP_DEFAULT_CPU_FREQ_MHZ_240=y
CONFIG_ESP_HTTPS_SERVER_ENABLE=y
CONFIG_ESP_MAIN_TASK_STACK_SIZE=10240
CONFIG_ESPTOOLPY_FLASHFREQ="80m"
CONFIG_ESPTOOLPY_FLASHFREQ_80M=y
CONFIG_ESPTOOLPY_FLASHMODE_QIO=y
CONFIG_ESPTOOLPY_FLASHSIZE_4MB=y
CONFIG_ESPTOOLPY_MONITOR_BAUD=460800
CONFIG_ESP_WIFI_ENT_FREE_DYNAMIC_BUFFER=y
CONFIG_ESP_WIFI_TASK_PINNED_TO_CORE_1=y
CONFIG_FREERTOS_GENERATE_RUN_TIME_STATS=y
CONFIG_FREERTOS_USE_STATS_FORMATTING_FUNCTIONS=y
CONFIG_FREERTOS_USE_TRACE_FACILITY=y
CONFIG_HEAP_POISONING_COMPREHENSIVE=y
CONFIG_HEAP_TRACING_STANDALONE=y
CONFIG_HTTPD_MAX_REQ_HDR_LEN=2048
CONFIG_LWIP_IPV6_AUTOCONFIG=y
CONFIG_LWIP_IPV6_DHCP6=y
CONFIG_LWIP_IPV6=y
CONFIG_LWIP_MAX_SOCKETS=20
CONFIG_LWIP_TCPIP_TASK_AFFINITY_CPU0=y
CONFIG_MBEDTLS_DYNAMIC_BUFFER=y
CONFIG_MBEDTLS_DYNAMIC_FREE_CONFIG_DATA=y
CONFIG_PARTITION_TABLE_CUSTOM_FILENAME="partitions.csv"
CONFIG_PARTITION_TABLE_CUSTOM=y
CONFIG_PARTITION_TABLE_FILENAME="partitions.csv"
CONFIG_PARTITION_TABLE_OFFSET=0x9000
CONFIG_PARTITION_TABLE_OFFSET=y
CONFIG_UART_ISR_IN_IRAM=y
CONFIG_LWIP_SNTP_MAX_SERVERS=2
```
